## t95max-custom-kernal/userpatches/u-boot/u-boot-sunxi/t95max_h618_defconfig
```kconfig
CONFIG_ARM=y
CONFIG_ARCH_SUNXI=y
CONFIG_DEFAULT_DEVICE_TREE="sun50i-h618-t95max"
CONFIG_MACH_SUN50I_H616=y
CONFIG_DRAM_SUN50I_H616_READ_CALIBRATION=y
CONFIG_DRAM_SUN50I_H616_UNKNOWN_FEATURE=y
CONFIG_MMC_SUNXI_SLOT_EXTRA=2
CONFIG_AXP313_POWER=y
```
